## net/dccp/ccids/Kconfig
```kconfig
menu "DCCP CCIDs Configuration"

config IP_DCCP_CCID2_DEBUG
	bool "CCID-2 debugging messages"
	---help---
	  Enable CCID-2 specific debugging messages.

	  The debugging output can additionally be toggled by setting the
	  ccid2_debug parameter to 0 or 1.

	  If in doubt, say N.

config IP_DCCP_CCID3
	bool "CCID-3 (TCP-Friendly)"
	def_bool y if (IP_DCCP = y || IP_DCCP = m)
	---help---
	  CCID-3 denotes TCP-Friendly Rate Control (TFRC), an equation-based
	  rate-controlled congestion control mechanism.  TFRC is designed to
	  be reasonably fair when competing for bandwidth with TCP-like flows,
	  where a flow is "reasonably fair" if its sending rate is generally
	  within a factor of two of the sending rate of a TCP flow under the
	  same conditions.  However, TFRC has a much lower variation of
	  throughput over time compared with TCP, which makes CCID-3 more
	  suitable than CCID-2 for applications such streaming media where a
	  relatively smooth sending rate is of importance.

	  CCID-3 is further described in RFC 4342,
	  http://www.ietf.org/rfc/rfc4342.txt

	  The TFRC congestion control algorithms were initially described in
	  RFC 5348.

	  This text was extracted from RFC 4340 (sec. 10.2),
	  http://www.ietf.org/rfc/rfc4340.txt

	  If in doubt, say N.

if IP_DCCP_CCID3
config IP_DCCP_CCID3_DEBUG
	bool "CCID-3 debugging messages"
	---help---
	  Enable CCID-3 specific debugging messages.

	  The debugging output can additionally be toggled by setting the
	  ccid3_debug parameter to 0 or 1.

	  If in doubt, say N.

choice
	prompt "Select method for measuring the packet size s in CCID-3"
	default IP_DCCP_CCID3_MEASURE_S_AS_MPS

config IP_DCCP_CCID3_MEASURE_S_AS_MPS
	bool "Always use MPS in place of s"
	---help---
	  This use is recommended as it is consistent with the initialisation
	  of X and suggested when s varies (rfc3448bis, (1) in section 4.1).
config IP_DCCP_CCID3_MEASURE_S_AS_AVG
	bool "Use moving average"
	---help---
	  An alternative way of tracking s, also supported by rfc3448bis.
	  This used to be the default for CCID-3 in previous kernels.
config IP_DCCP_CCID3_MEASURE_S_AS_MAX
	bool "Track the maximum payload length"
	---help---
	  An experimental method based on tracking the maximum packet size.
endchoice
endif	# IP_DCCP_CCID3

config IP_DCCP_CCID4
	bool "CCID-4 (TCP-Friendly, Small Packet Variant)"
	def_bool y if (IP_DCCP = y || IP_DCCP = m)
	select IP_DCCP_TFRC_LIB
	---help---
	  CCID-4 denotes Congestion Control Identifier 4, the Small-Packet
	  variant of TCP-Friendly Rate Control (TFRC) for use with the Datagram
	  Congestion Control Protocol (DCCP).  CCID 4 uses TFRC-SP (RFC 4828), a
	  variant of TFRC designed for applications that send small packets. The
	  goal for TFRC-SP is to achieve roughly the same bandwidth in bits per
	  second (bps) as a TCP flow using packets of up to 1500 bytes but
	  experiencing the same level of congestion.  CCID-4 is for experimental
	  use, for senders that send small packets and would like a TCP-friendly
	  sending rate, possibly with Explicit Congestion Notification (ECN),
	  while minimizing abrupt rate changes.

	  CCID-4 is specified in RFC 5622.

	  If in doubt, say N.

if IP_DCCP_CCID4
config IP_DCCP_CCID4_DEBUG
	bool "CCID-4 debugging messages"
	---help---
	  Enable CCID-4 specific debugging messages.

	  The debugging output can additionally be toggled by setting the
	  ccid4_debug parameter to 0 or 1.

	  If in doubt, say N.

# XXX Hack: this could be combined into a TFRC option. Left it for the moment
choice
	prompt "Select method for measuring the packet size s in CCID-4"
	default IP_DCCP_CCID4_MEASURE_S_AS_MPS

config IP_DCCP_CCID4_MEASURE_S_AS_MPS
	bool "Always use MPS in place of s"
	---help---
	  This use is recommended as it is consistent with the initialisation
	  of X and suggested when s varies (rfc3448bis, (1) in section 4.1).
config IP_DCCP_CCID4_MEASURE_S_AS_AVG
	bool "Use moving average"
	---help---
	  An alternative way of tracking s, also supported by rfc3448bis.
	  This used to be the default for CCID-3 in previous kernels.
config IP_DCCP_CCID4_MEASURE_S_AS_MAX
	bool "Track the maximum payload length"
	---help---
	  An experimental method based on tracking the maximum packet size.
endchoice
endif	# IP_DCCP_CCID4

config IP_DCCP_TFRC_LIB
	def_bool y if IP_DCCP_CCID3

config IP_DCCP_TFRC_SP_LIB
	def_bool y if IP_DCCP_CCID4

config IP_DCCP_TFRC_DEBUG
	def_bool y if (IP_DCCP_CCID3_DEBUG || IP_DCCP_CCID4_DEBUG)

config IP_DCCP_CCID0
	bool "CCID-ZERO (UDP-like) sample kernel module"
	def_bool n
	---help---
	  This is a sample kernel module to illustrate the integration of new
	  CCID plugin modules into DCCP. It can also be used for performance
	  testing, but is not meant for deployment since it operates without
	  any congestion control. It is a no-op CCID, its identifier is 248.

	  Say N.

endmenu
```
